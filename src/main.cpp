/**
  ******************************************************************************
  * @file           : main.cpp
  * @brief          : Main program body
  ******************************************************************************
  ** This notice applies to any and all portions of this file
  * that are not between comment pairs USER CODE BEGIN and
  * USER CODE END. Other portions of this file, whether 
  * inserted by the user or by software development tools
  * are owned by their respective copyright owners.
  *
  * COPYRIGHT(c) 2018 STMicroelectronics
  *
  * Redistribution and use in source and binary forms, with or without modification,
  * are permitted provided that the following conditions are met:
  *   1. Redistributions of source code must retain the above copyright notice,
  *      this list of conditions and the following disclaimer.
  *   2. Redistributions in binary form must reproduce the above copyright notice,
  *      this list of conditions and the following disclaimer in the documentation
  *      and/or other materials provided with the distribution.
  *   3. Neither the name of STMicroelectronics nor the names of its contributors
  *      may be used to endorse or promote products derived from this software
  *      without specific prior written permission.
  *
  * THIS SOFTWARE IS PROVIDED BY THE COPYRIGHT HOLDERS AND CONTRIBUTORS "AS IS"
  * AND ANY EXPRESS OR IMPLIED WARRANTIES, INCLUDING, BUT NOT LIMITED TO, THE
  * IMPLIED WARRANTIES OF MERCHANTABILITY AND FITNESS FOR A PARTICULAR PURPOSE ARE
  * DISCLAIMED. IN NO EVENT SHALL THE COPYRIGHT HOLDER OR CONTRIBUTORS BE LIABLE
  * FOR ANY DIRECT, INDIRECT, INCIDENTAL, SPECIAL, EXEMPLARY, OR CONSEQUENTIAL
  * DAMAGES (INCLUDING, BUT NOT LIMITED TO, PROCUREMENT OF SUBSTITUTE GOODS OR
  * SERVICES; LOSS OF USE, DATA, OR PROFITS; OR BUSINESS INTERRUPTION) HOWEVER
  * CAUSED AND ON ANY THEORY OF LIABILITY, WHETHER IN CONTRACT, STRICT LIABILITY,
  * OR TORT (INCLUDING NEGLIGENCE OR OTHERWISE) ARISING IN ANY WAY OUT OF THE USE
  * OF THIS SOFTWARE, EVEN IF ADVISED OF THE POSSIBILITY OF SUCH DAMAGE.
  *
  ******************************************************************************
  * @file    main.cpp
  * @author  Ostap Kostyk
  * @brief   main program body
  *
  ******************************************************************************
  * Copyright (C) 2018  Ostap Kostyk
  * This notice applies to any and all portions of this file
  * that are between comment pairs USER CODE BEGIN and
  * USER CODE END.
  *
  * This program is free software: you can redistribute it and/or modify
  * it under the terms of the GNU General Public License as published by
  * the Free Software Foundation, either version 3 of the License, or
  * (at your option) any later version.
  *
  * This program is distributed in the hope that it will be useful,
  * but WITHOUT ANY WARRANTY; without even the implied warranty of
  * MERCHANTABILITY or FITNESS FOR A PARTICULAR PURPOSE.  See the
  * GNU General Public License for more details.
  *
  * You should have received a copy of the GNU General Public License
  * along with this program.  If not, see <http://www.gnu.org/licenses/>.
  ******************************************************************************
  * Author contact information: Ostap Kostyk, email: ostap.kostyk@gmail.com
  ******************************************************************************
  */

/* Includes ------------------------------------------------------------------*/
#include "main.h"
#include "stm32f1xx_hal.h"

/* USER CODE BEGIN Includes */
extern "C" {
#include "My_hal_uart_stm32f1xx.h"
#include <stdio.h>
#include "CircularBuffer.h"
#include "eeprom.h"
#include "ESP8266_Interface.h"
}
#include "Timer.h"
#include "LED.h"
#include "Button.h"
#include "ESP8266.hpp"
#include "HTTP_Server.hpp"

using namespace mTimer;
using namespace OKO_ESP8266;
using namespace OKO_HTTP_SERVER;
/* USER CODE END Includes */

/* Private variables ---------------------------------------------------------*/
UART_HandleTypeDef huart1;
UART_HandleTypeDef huart2;

/* USER CODE BEGIN PV */

/* Private variables ---------------------------------------------------------*/

/* circular buffer structures (not a buffers themselves) for standard input/output */
circular_buffer StdInOut_cb_Rx;
circular_buffer StdInOut_cb_Tx;

#ifdef EEPROM_EMULATION_EN
/* EEPROM Emulation */
/* Virtual address defined by the user: 0xFFFF value is prohibited */
EE_Data_t EE_Data;
uint16_t VirtAddVarTab[NB_OF_VAR];
uint16_t EE_Status;
#endif

#ifdef EXAMPLE_TIMER
Timer TestTimer{};
#endif

/*   LEDs   */
/* Here we create LED instances. Port and Pin declarations came from autogenerated by CubeMX code */
LED   LED2{LED2_GPIO_Port, LED2_Pin, LED::eActiveLevel::High};
LED   LED3{LED3_GPIO_Port, LED3_Pin, LED::eActiveLevel::High};
LED   LED4{LED4_GPIO_Port, LED4_Pin, LED::eActiveLevel::Low};
LED   LED5{LED5_GPIO_Port, LED5_Pin, LED::eActiveLevel::Low};
LED   LED6{LED6_GPIO_Port, LED6_Pin, LED::eActiveLevel::Low};

enum class LEDMode : uint16_t {Off=0, On, Blink};

LEDMode BlueLEDMode = LEDMode::Off;

/*   Buttons  */
/* Here we create Buttons instances. Port and Pin declarations came from autogenerated by CubeMX code */
Button Button1{Button1_GPIO_Port, Button1_Pin, Button::ePressedLevel::Low};

/* Below are sizes of In and Out circular buffers for standard input/output */
#define STD_IN_CB_SIZE      200
#define STD_OUT_CB_SIZE     200

/* Create ESP instance */
ESP ESP1{ESP1_HUART_NUM};

/* Create HTTP server instance */
HTTP_Server MyHTTPServer{&ESP1};

/*************************************************************
 *      TCP/IP communication
 *************************************************************/
static char AccessPointName[EE_WIFI_SSID_LEN] = "ESP";
static char AccessPointPassword[] = "1234567890";
static const uint32_t AP_DefaultIP = 0xc0a80001;
static const uint32_t AP_DefaultNetMask = 0xFFFFFF00;

#define WIFI_RX_DATA_BUF_SZ     500

static uint8_t  WiFi_Step = 0;

/*************************************************************
 *
 *************************************************************/

/* USER CODE END PV */

/* Private function prototypes -----------------------------------------------*/
void SystemClock_Config(void);
static void MX_GPIO_Init(void);
static void MX_USART1_UART_Init(void);
static void MX_USART2_UART_Init(void);

/* USER CODE BEGIN PFP */
/* Private function prototypes -----------------------------------------------*/

/* USER CODE END PFP */

/* USER CODE BEGIN 0 */

void BlockingFaultHandler(void)
{
   while(1)
   {

   }
}

void HAL_SYSTICK_Callback(void)
{
/*Warning: timers handler below is called from interrupt so can influence application significantly if there are many timers created.
           If this is a problem then the handler should be moved outside interrupt (can be called using global variable incremented here).
           Timers will be less accurate in this case */
Timer::Tick();  /*  handles all timers created in IRQ. */
HAL_IncTick();
}

/* Hardware-dependent function called from LED class */
void LEDWritePin (GPIO_TypeDef* Port, uint16_t Pin, GPIO_PinState PinState)
{
    HAL_GPIO_WritePin(Port, Pin, PinState);
}

/* Hardware-dependent function called from Button class */
int ButtonReadPin (PORT_DEF Port, PIN_NUM_DEF Pin)
{
    if(HAL_GPIO_ReadPin(Port, Pin) == GPIO_PIN_SET) { return 1; }

    return 0;
}

/* Blue LED control with saving last state to EEPROM */
void BlueLEDSwitchMode(LEDMode mode)
{
bool WriteToEEprom = true;

    switch(mode)
    {
    case LEDMode::On:
        BlueLEDMode = LEDMode::On;
        LED3.On();
        EE_Data.BlueLEDMode = (uint16_t)LEDMode::On;
        break;

    case LEDMode::Blink:
        BlueLEDMode = LEDMode::Blink;
        LED3.Blink(EE_Data.BlueLEDOnTime, EE_Data.BlueLEDOffTime, true);
        EE_Data.BlueLEDMode = (uint16_t)LEDMode::Blink;
        break;

    case LEDMode::Off:
        BlueLEDMode = LEDMode::Off;
        LED3.Off();
        EE_Data.BlueLEDMode = (uint16_t)LEDMode::Off;
        break;

    default:
        BlueLEDMode = LEDMode::Off;
        LED3.Off();
        EE_Data.BlueLEDMode = (uint16_t)LEDMode::Off;
        WriteToEEprom = false;
        break;
    }

#ifdef EEPROM_EMULATION_EN
    if(WriteToEEprom && EE_Status == 0)
    {
        EE_Status += EE_WriteElem((uint16_t*)&EE_Data.BlueLEDMode, sizeof(EE_Data.BlueLEDMode));
        if(EE_Status) { debug_print("EE Write ERROR (BlueLEDMode):%x\r\n", EE_Status); }
    }
#endif
}

/* Read-out settings of Blue LED from HTTP request, apply it and save to EEPROM */
void ReadLEDSettingsFromHTTP(void)
{
    if(HTTPVariable::HTTPVariableReceivedFlag)
    {
        if(HTTP_VAR_BlueLEDBlinkTimeOn.NewValueReceived() && HTTP_VAR_BlueLEDBlinkTimeOff.NewValueReceived())   //  "BlueLEDBlinkTimeOn" and "BlueLEDBlinkTimeOff" are received
        {
            if(HTTP_VAR_BlueLEDBlinkTimeOn.GetValueInteger() > 0 && HTTP_VAR_BlueLEDBlinkTimeOff.GetValueInteger() > 0)
            {
                EE_Data.BlueLEDOnTime = HTTP_VAR_BlueLEDBlinkTimeOn.GetValueInteger();
                EE_Data.BlueLEDOffTime = HTTP_VAR_BlueLEDBlinkTimeOff.GetValueInteger();
                if(EE_Status == 0)
                {
#ifdef EEPROM_EMULATION_EN
                    EE_Status += EE_WriteElem((uint16_t*)&EE_Data.BlueLEDOnTime, sizeof(EE_Data.BlueLEDOnTime));
                    EE_Status += EE_WriteElem((uint16_t*)&EE_Data.BlueLEDOffTime, sizeof(EE_Data.BlueLEDOffTime));
                    if(EE_Status) { debug_print("EE Write ERROR:%x\r\n", EE_Status); }
#endif
                }
                if(BlueLEDMode == LEDMode::Blink)
                {
                    LED3.Blink(EE_Data.BlueLEDOnTime, EE_Data.BlueLEDOffTime, true);
                }
            }
        }
    }
}

/* Read-out WiFi SSID from HTTP request, validate it and save to EEPROM */
void UpdateSSIDfromHTTP(void)
{
int pos, len;
char* pWiFiSSIDTxt;

    if(HTTPVariable::HTTPVariableReceivedFlag)
    {
        if(HTTP_VAR_WiFiSSID.NewValueReceived())   /* "WiFiSSID" received */
        {
            /* validate new name: */
            pos = 0;
            pWiFiSSIDTxt = HTTP_VAR_WiFiSSID.GetText();
            if(pWiFiSSIDTxt == 0) { return; }
            len = strlen(pWiFiSSIDTxt);
            sscanf(pWiFiSSIDTxt, "%*[0-9a-zA-Z_-]%n", &pos);  /*  allowed symbols are numbers, a-z, A-Z and underscore */
            if(pos && pos == len && len < EE_WIFI_SSID_LEN)  /*  if string is not empty and contain only allowed symbols */
            {
                /* save new name: */
                strncpy(EE_Data.WiFi_SSID, pWiFiSSIDTxt, EE_WIFI_SSID_LEN-1);    /*  update EEPROM data before saving to flash */
#ifdef EEPROM_EMULATION_EN
                EE_WriteElem((uint16_t*)&EE_Data.WiFi_SSID, EE_WIFI_SSID_LEN);  /*  save to EEPROM */
#endif
            }
        }
    }
}

/* HTTP pages rendering: generate dynamic parts of HTTP pages */
bool HTTP_RenderPage(int PageIndex, char *pHostName, bool **pProcessSemaphore)
{
size_t len;
char *pText;

    pProcessSemaphore = 0;  /*  no semaphore assigned */

    switch(PageIndex)
    {
    /* index.html */
    case 0:
        if(HTTPVariable::HTTPVariableReceivedFlag)    /*  Global variable, becomes true if any variable from global list received (to save CPU time) */
        {
            if(HTTP_VAR_BlueLEDMode.NewValueReceived())   /*  "BlueLEDMode" received (Text variable) */
            {
                pText = HTTP_VAR_BlueLEDMode.GetText();

                if(0 == strcmp(pText, "ON"))
                {
                    BlueLEDSwitchMode(LEDMode::On); /* turn on blue LED */
                }
                else if(0 == strcmp(pText, "OFF"))
                {
                    BlueLEDSwitchMode(LEDMode::Off); /* turn off blue LED */
                }
                else if(0 == strcmp(pText, "BLINK"))
                {
                    BlueLEDSwitchMode(LEDMode::Blink);  /*  Blink the blue LED */
                }
            }
        }

        len = strlen(HTTP_Index_Body2); /*  HTTP_Index_Body2 string created outside, need to check if it is not empty before writing to it */

        if(len == 0) { return false; }  /*  internal error, page cannot be generated */

        /* Generate dynamic part of index.htm page showing current LED mode */
        switch(BlueLEDMode)
        {
        case LEDMode::On:    snprintf(HTTP_Index_Body2, len+1, "1"); break;        /*  number must fit HTML code */
        case LEDMode::Blink: snprintf(HTTP_Index_Body2, len+1, "2"); break;
        default:
        case LEDMode::Off:   snprintf(HTTP_Index_Body2, len+1, "0"); break;
        }

        return true;

        break;

        /* settings.html */
        case 1:
            /* First read-out data from HTTP request to apply it and immediately generate new status info for the page */
            ReadLEDSettingsFromHTTP();
            UpdateSSIDfromHTTP();
            /* Generate dynamic parts of settings.html */
            snprintf(pHTTP_StringForRendering, HTML_RENDER_STR_SIZE-1, "<p id=\"BLEDOnAct\", visibility: hidden>%d</p>\n<p id=\"BLEDOffAct\", visibility: hidden>%d</p>", (int)EE_Data.BlueLEDOnTime, (int)EE_Data.BlueLEDOffTime);
            snprintf(pHTTP_StringForRendering2, HTML_RENDER_STR_SIZE2-1, "Actual: \"%s\"<br />", EE_Data.WiFi_SSID);
            return true;
            break;

        default:
            return false;
    }

    return false;
}

/* USER CODE END 0 */

/**
  * @brief  The application entry point.
  *
  * @retval None
  */
int main(void)
{
  /* USER CODE BEGIN 1 */
  memmgr_init();

#ifdef EEPROM_EMULATION_EN
  /* EEPROM EMULATION-RELATED */
  EE_AddrInit();
  /* Unlock the Flash Program Erase controller */
  HAL_FLASH_Unlock();

  /* Init EEPROM Emulation */
  EE_Status = EE_Init();

  /* END OF EEPROM EMULATION-RELATED */
#endif

  /* USER CODE END 1 */

  /* MCU Configuration----------------------------------------------------------*/

  /* Reset of all peripherals, Initializes the Flash interface and the Systick. */
  HAL_Init();

  /* USER CODE BEGIN Init */

  /* USER CODE END Init */

  /* Configure the system clock */
  SystemClock_Config();

  /* USER CODE BEGIN SysInit */

  /* USER CODE END SysInit */

  /* Initialize all configured peripherals */
  MX_GPIO_Init();
  MX_USART1_UART_Init();
  MX_USART2_UART_Init();
  /* USER CODE BEGIN 2 */

  /* Configure UART for std in/out */
  if(SUCCESS != Init_USART_CB(&stdinout_huart, &StdInOut_cb_Rx, &StdInOut_cb_Tx, STD_IN_CB_SIZE, STD_OUT_CB_SIZE, sizeof(U8)))
  {
      BlockingFaultHandler();
  }
  Start_USART_Rx_IT(&stdinout_huart);

  /* stdout test */
  printf("Copyright (c) 2018 Ostap Kostyk\r\n");
  debug_print("START\r\n");

#ifdef EXAMPLE_TIMER
  //Timer example
  TestTimer.Set(_1sec_);
  TestTimer.Reset();
#endif

  /* Turn Off all LEDs at start */
  LED2.Off();
  LED4.Off();
  LED5.Off();
  LED6.Off();

#ifdef EEPROM_EMULATION_EN
  if(0 == EE_Status)
  {
      EE_Status = EE_InitData();
      if(EE_Status) { debug_print("EE Data Init ERROR:%x\r\n", EE_Status); }
  }
  else
  {
      debug_print("EE Init ERROR:%x\r\n", EE_Status);
  }
#endif

#ifdef EEPROM_EMULATION_EN
  /* read-out settings from flash */

  /* read magic number from EEPROM to identify if EEPROM is empty after flashing memory and therefore data are incorrect */
  EE_Status += EE_ReadElem((uint16_t*)&EE_Data.Init, sizeof(EE_Data.Init));
  /* restore Blue LED settings from EEPROM */
  EE_Status += EE_ReadElem((uint16_t*)&EE_Data.BlueLEDOnTime, sizeof(EE_Data.BlueLEDOnTime));
  EE_Status += EE_ReadElem((uint16_t*)&EE_Data.BlueLEDOffTime, sizeof(EE_Data.BlueLEDOffTime));
  EE_Status += EE_ReadElem((uint16_t*)&EE_Data.BlueLEDMode, sizeof(EE_Data.BlueLEDMode));
  if(EE_Status)     /*  error occurred while reading EEPROM */
  {
      EE_Data.BlueLEDOnTime = _100ms_;
      EE_Data.BlueLEDOffTime = _100ms_;
      debug_print("EE Read ERROR:%x\r\n", EE_Status);
      LED3.Blink(EE_Data.BlueLEDOnTime, EE_Data.BlueLEDOffTime, true);  /*  indicate problem by fast blinking */
  }
  else      /*  data have been read-out correctly from EEPROM */
  {
      if(EE_Data.Init != EE_INIT_MAGIC_NUMBER)  /*  EEPROM is uninitialized, write default values */
      {
          /* write default SSID to eeprom */
          strncpy(EE_Data.WiFi_SSID, AccessPointName, EE_WIFI_SSID_LEN-1);
          EE_Status += EE_WriteElem((uint16_t*)&EE_Data.WiFi_SSID, EE_WIFI_SSID_LEN);
          /* write default settings of blue LED */
          EE_Data.BlueLEDMode = (uint16_t)LEDMode::Off;
          EE_Data.BlueLEDOnTime = _100ms_;
          EE_Data.BlueLEDOffTime = _900ms_;
          EE_Status += EE_WriteElem((uint16_t*)&EE_Data.BlueLEDMode, sizeof(EE_Data.BlueLEDMode));
          EE_Status += EE_WriteElem((uint16_t*)&EE_Data.BlueLEDOnTime, sizeof(EE_Data.BlueLEDOnTime));
          EE_Status += EE_WriteElem((uint16_t*)&EE_Data.BlueLEDOffTime, sizeof(EE_Data.BlueLEDOffTime));
          if(EE_Status == 0)    /*  all data saved successfully, write magic number to EEPROM indicating that the data are correct */
          {
              EE_Data.Init = EE_INIT_MAGIC_NUMBER;
              EE_Status += EE_WriteElem((uint16_t*)&EE_Data.Init, sizeof(EE_Data.Init));
          }
      }
      else      /*  data in EEPROM are OK, restore WiFi SSID */
      {
          if(strlen(EE_Data.WiFi_SSID) < EE_WIFI_SSID_LEN)
          {
              strcpy(AccessPointName, EE_Data.WiFi_SSID);
          }
      }

      BlueLEDSwitchMode((LEDMode)EE_Data.BlueLEDMode);  /*  start blue LED according to it's settings from EEPROM */
      debug_print("BlueLEDMode = %u\r\n", EE_Data.BlueLEDMode);
  }

#endif  /* END OF #ifdef EEPROM_EMULATION_EN */

  /* Start WiFi module */
  ESP1.ModuleToggle(ESP::eModuleToggle::Enable);

  /* USER CODE END 2 */

  /* Infinite loop */
  /* USER CODE BEGIN WHILE */
  while (1)
  {
  /* USER CODE END WHILE */

  /* USER CODE BEGIN 3 */

    /* Handle LEDs */
    LED::Ctrl();

    /* Handle Buttons */
    Button::Ctrl();

    /* Test Button functions */
    if(Button1.GetState() == Button::eState::Pressed) { LED2.On(); }    /*  Turn LED2 On while button is pressed */
    else                                              { LED2.Off(); }   /*  Turn LED2 Off while button is released */

    if(Button1.PressedEvent())  /*  Button has been pressed event */
    {
        Button1.ClearPressedEvent();    /*  Clear event */
        LED4.Off();
    }

    if(Button1.ReleasedEvent())
    {
        Button1.ClearReleasedEvent();
        /*  turn LED4 On for a time of which button kept pressed last time (to test Button, LED and Timer classes) */
        LED4.BlinkNtimes(Button1.GetPressedTime(), _100ms_, 1);
    }

/****************************************************
 *          WiFi Communication
 ****************************************************/
ESP1.Process();     /*  WiFi module main handler (can be skipped when WiFi communication is not needed to save CPU resources) */

  if(ESP1.isModuleReady())  /*  Module replied on test request so it is alive */
  {
      switch(WiFi_Step)
      {
      /* First, start Access Point and Server */
      case 0:
      do
      {
        if(ESP1.GetCurrentModuleMode() == ESP::eModuleMode::Undefined)
        {
            ESP1.SwitchToAccessPointMode(AccessPointName, (char*)AccessPointPassword, 6, ESP::eECNType::WPA2_PSK);  /*  Switches WiFi module to AccessPoint mode (not Station) */
        }
        else if(ESP1.GetCurrentModuleMode() == ESP::eModuleMode::AccessPoint)   /*  switched to AccessPoint mode successfully */
        {
          /*  start AP */
          if(ESP1.LocalAccessPointState() == ESP::eAccessPointState::Started)   /*  AccessPoint started */
          {
              /*  start server */
              switch(ESP1.GetServerState())
              {
              case ESP::eServerState::Connected:
                  if(ESP1.SetAccessPointIP(AP_DefaultIP, AP_DefaultIP, AP_DefaultNetMask)) break;    //  wait for IP change
                  WiFi_Step++;  /*  go to next step */
                  break;

              case ESP::eServerState::Disconnected:
              case ESP::eServerState::Undefined:
                  ESP1.StartServer((unsigned int)80);
                  break;

              case ESP::eServerState::Error:
              case ESP::eServerState::ConnectTimeout:
              default:
                  //TODO
                  break;
              }
          }
        }
        else
        {
          /* Error */
        }
      }while(0);
      break;

      case 1:
          if(ESP1.GetServerState() != ESP::eServerState::Connected)     /*  if server stopped (or module restarted, etc.) - restart it */
          {
              WiFi_Step = 0;
              break;
          }

          /*  run HTTP server */
          MyHTTPServer.Handle();
          break;

      default:
          WiFi_Step = 0;
          break;
      }
  }
  else
  {

  }

  HTTPVariable::HTTPVariableReceivedFlag = false; //  clear global flag indicating that there is/are variable(s) received from client (this flag indicates new data coming from HTTP client)

/******** END OF ESP PART ******/

#if 0
    // Reception from stdin example:
    char mystr[20] = "";

    /* Attention! Next line blocks execution of main cycle until user enters text line! */
    fgets(mystr, 19, stdin);

    if(strstr(mystr, "ok")) { debug_print("Received\r\n"); }
    // End of Reception from stdin example
#endif
  }
  /* USER CODE END 3 */

}

/**
  * @brief System Clock Configuration
  * @retval None
  */
void SystemClock_Config(void)
{

  RCC_OscInitTypeDef RCC_OscInitStruct;
  RCC_ClkInitTypeDef RCC_ClkInitStruct;

    /**Initializes the CPU, AHB and APB busses clocks 
    */
  RCC_OscInitStruct.OscillatorType = RCC_OSCILLATORTYPE_HSE;
  RCC_OscInitStruct.HSEState = RCC_HSE_ON;
  RCC_OscInitStruct.HSEPredivValue = RCC_HSE_PREDIV_DIV2;
  RCC_OscInitStruct.HSIState = RCC_HSI_ON;
  RCC_OscInitStruct.PLL.PLLState = RCC_PLL_ON;
  RCC_OscInitStruct.PLL.PLLSource = RCC_PLLSOURCE_HSE;
  RCC_OscInitStruct.PLL.PLLMUL = RCC_PLL_MUL9;
  if (HAL_RCC_OscConfig(&RCC_OscInitStruct) != HAL_OK)
  {
    _Error_Handler(__FILE__, __LINE__);
  }

    /**Initializes the CPU, AHB and APB busses clocks 
    */
  RCC_ClkInitStruct.ClockType = RCC_CLOCKTYPE_HCLK|RCC_CLOCKTYPE_SYSCLK
                              |RCC_CLOCKTYPE_PCLK1|RCC_CLOCKTYPE_PCLK2;
  RCC_ClkInitStruct.SYSCLKSource = RCC_SYSCLKSOURCE_PLLCLK;
  RCC_ClkInitStruct.AHBCLKDivider = RCC_SYSCLK_DIV1;
  RCC_ClkInitStruct.APB1CLKDivider = RCC_HCLK_DIV2;
  RCC_ClkInitStruct.APB2CLKDivider = RCC_HCLK_DIV1;

  if (HAL_RCC_ClockConfig(&RCC_ClkInitStruct, FLASH_LATENCY_2) != HAL_OK)
  {
    _Error_Handler(__FILE__, __LINE__);
  }

    /**Configure the Systick interrupt time 
    */
  HAL_SYSTICK_Config(HAL_RCC_GetHCLKFreq()/1000);

    /**Configure the Systick 
    */
  HAL_SYSTICK_CLKSourceConfig(SYSTICK_CLKSOURCE_HCLK);

  /* SysTick_IRQn interrupt configuration */
  HAL_NVIC_SetPriority(SysTick_IRQn, 0, 0);
}

/* USART1 init function */
static void MX_USART1_UART_Init(void)
{

  huart1.Instance = USART1;
  huart1.Init.BaudRate = 115200;
  huart1.Init.WordLength = UART_WORDLENGTH_8B;
  huart1.Init.StopBits = UART_STOPBITS_1;
  huart1.Init.Parity = UART_PARITY_NONE;
  huart1.Init.Mode = UART_MODE_TX_RX;
  huart1.Init.HwFlowCtl = UART_HWCONTROL_NONE;
  huart1.Init.OverSampling = UART_OVERSAMPLING_16;
  if (HAL_UART_Init(&huart1) != HAL_OK)
  {
    _Error_Handler(__FILE__, __LINE__);
  }

}

/* USART2 init function */
static void MX_USART2_UART_Init(void)
{

  huart2.Instance = USART2;
  huart2.Init.BaudRate = 115200;
  huart2.Init.WordLength = UART_WORDLENGTH_8B;
  huart2.Init.StopBits = UART_STOPBITS_1;
  huart2.Init.Parity = UART_PARITY_NONE;
  huart2.Init.Mode = UART_MODE_TX_RX;
  huart2.Init.HwFlowCtl = UART_HWCONTROL_NONE;
  huart2.Init.OverSampling = UART_OVERSAMPLING_16;
  if (HAL_UART_Init(&huart2) != HAL_OK)
  {
    _Error_Handler(__FILE__, __LINE__);
  }

}

/** Configure pins as 
        * Analog 
        * Input 
        * Output
        * EVENT_OUT
        * EXTI
*/
static void MX_GPIO_Init(void)
{

  GPIO_InitTypeDef GPIO_InitStruct;

  /* GPIO Ports Clock Enable */
  __HAL_RCC_GPIOD_CLK_ENABLE();
  __HAL_RCC_GPIOA_CLK_ENABLE();
  __HAL_RCC_GPIOB_CLK_ENABLE();

  /*Configure GPIO pin Output Level */
  HAL_GPIO_WritePin(GPIOA, ESP_RST_Pin|ESP_CH_EN_Pin, GPIO_PIN_RESET);

  /*Configure GPIO pin Output Level */
  HAL_GPIO_WritePin(GPIOB, LED1_Pin|LED2_Pin|LED3_Pin, GPIO_PIN_RESET);

  /*Configure GPIO pin Output Level */
  HAL_GPIO_WritePin(GPIOB, LED4_Pin|LED5_Pin, GPIO_PIN_SET);

  /*Configure GPIO pin Output Level */
  HAL_GPIO_WritePin(LED6_GPIO_Port, LED6_Pin, GPIO_PIN_SET);

  /*Configure GPIO pins : ESP_RST_Pin ESP_CH_EN_Pin LED6_Pin */
  GPIO_InitStruct.Pin = ESP_RST_Pin|ESP_CH_EN_Pin|LED6_Pin;
  GPIO_InitStruct.Mode = GPIO_MODE_OUTPUT_PP;
  GPIO_InitStruct.Speed = GPIO_SPEED_FREQ_LOW;
  HAL_GPIO_Init(GPIOA, &GPIO_InitStruct);

  /*Configure GPIO pins : LED1_Pin LED2_Pin LED3_Pin LED4_Pin 
                           LED5_Pin */
  GPIO_InitStruct.Pin = LED1_Pin|LED2_Pin|LED3_Pin|LED4_Pin 
                          |LED5_Pin;
  GPIO_InitStruct.Mode = GPIO_MODE_OUTPUT_PP;
  GPIO_InitStruct.Speed = GPIO_SPEED_FREQ_LOW;
  HAL_GPIO_Init(GPIOB, &GPIO_InitStruct);

  /*Configure GPIO pin : Button1_Pin */
  GPIO_InitStruct.Pin = Button1_Pin;
  GPIO_InitStruct.Mode = GPIO_MODE_INPUT;
  GPIO_InitStruct.Pull = GPIO_PULLUP;
  HAL_GPIO_Init(Button1_GPIO_Port, &GPIO_InitStruct);

}

/* USER CODE BEGIN 4 */

/* USER CODE END 4 */

/**
  * @brief  This function is executed in case of error occurrence.
  * @param  file: The file name as string.
  * @param  line: The line in file as a number.
  * @retval None
  */
void _Error_Handler(char *file, int line)
{
  /* USER CODE BEGIN Error_Handler_Debug */
  /* User can add his own implementation to report the HAL error return state */
  while(1)
  {
  }
  /* USER CODE END Error_Handler_Debug */
}

#ifdef  USE_FULL_ASSERT
/**
  * @brief  Reports the name of the source file and the source line number
  *         where the assert_param error has occurred.
  * @param  file: pointer to the source file name
  * @param  line: assert_param error line source number
  * @retval None
  */
void assert_failed(uint8_t* file, uint32_t line)
{ 
  /* USER CODE BEGIN 6 */
  /* User can add his own implementation to report the file name and line number,
    ex: printf("Wrong parameters value: file %s on line %d\r\n", file, line) */
  /* USER CODE END 6 */
}
#endif /* USE_FULL_ASSERT */

/**
  * @}
  */

/**
  * @}
  */

/************************ (C) COPYRIGHT STMicroelectronics *****END OF FILE****/
